// SPDX-License-Identifier: GPL-2.0-or-later OR MIT

#include "mt7621_arcadyan_wg4xx223.dtsi"

/ {
	compatible = "beeline,smartbox-flash", "mediatek,mt7621-soc";
	model = "Beeline SmartBox Flash";

	leds {	
			label = "blue:wan";
			gpios = <&gpio0 14 GPIO_ACTIVE_LOW>;
		
	};
};
